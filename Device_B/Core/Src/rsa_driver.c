/*
 * rsa_driver.c
 *
 *  Created on: 6 lis 2024
 *      Author: Igor
 */


//#include "crypto.h"

#include "rsa_driver.h"
#include "ring_buffer.h"
#include "rsa_keys.h"
#include "random_message.h"
/////////////////////////////Random message//////////////////////
#define MESSAGE_LENGTH 16 //- 16 bytes message
uint8_t Message[MESSAGE_LENGTH];


////////////////////////////END- Random message///////////////////

uint8_t preallocated_buffer[4096]; /* buffer required for internal allocation of memory */

/******************************************************************************/
/************************** RSA 2048 Test Vector  ****************************/
/******************************************************************************/


const uint8_t PublicExponent[] =
  {
    0x01, 0x00, 0x01
  };


//PRIVATE Y1 Modulus X1 - czyli modulus dla y1
const uint8_t PrivateExponent[] = {
    0x01, 0x29, 0x27, 0x8e, 0x8c, 0x5f, 0x05, 0x16, 0xbf, 0xfa, 0x44, 0xac,
    0x8e, 0x36, 0x48, 0x35, 0x5f, 0x05, 0x22, 0x40, 0x2f, 0xd5, 0xeb, 0xfd,
    0xb6, 0xbd, 0x43, 0xb4, 0x13, 0xe6, 0x91, 0x1d, 0x99, 0x5c, 0xb6, 0x59,
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    0x1e, 0xff, 0xce, 0xa9};

const uint8_t Modulus[] = {
    0xaf, 0x23, 0x14, 0xcb, 0xf2, 0x0f, 0x1a, 0x88, 0x8b, 0x4c, 0x7e, 0xad,
    0x2c, 0xe0, 0x67, 0xc9, 0x74, 0x41, 0xa5, 0x32, 0x53, 0xda, 0x5f, 0xe2,
    0xb3, 0x30, 0x58, 0x04, 0x9c, 0xd3, 0x44, 0x38, 0x24, 0x11, 0xd6, 0xa3,
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    0xe5, 0xd5, 0xcb, 0x05};


/* String of entropy */
uint8_t entropy_data[32] =
  {
    0x91, 0x20, 0x1a, 0x18, 0x9b, 0x6d, 0x1a, 0xa7,
    0x0e, 0x69, 0x57, 0x6f, 0x36, 0xb6, 0xaa, 0x88,
    0x55, 0xfd, 0x4a, 0x7f, 0x97, 0xe9, 0x72, 0x69,
    0xb6, 0x60, 0x88, 0x78, 0xe1, 0x9c, 0x8c, 0xa5
  };

uint8_t output[2048/8];
int32_t outputSize = 0;

int32_t status = RSA_ERR_GENERIC;

RSApubKey_stt PubKey_st;
RSAprivKey_stt PrivKey_st;

void RSA_Driver_Get_Random_Message(){
	Random_message_init();
		 GenerateRandomMessage(Message, sizeof(Message));

		    /////////////////////////////////////WIADOMOSC TESTOWA/////////////////////////////////////////
		    HAL_UART_Transmit(&huart1, "Losowa wiadomosc:\n", 18, 1000);
		    HAL_UART_Transmit(&huart1, Message, 17, 1000);
		    /////////////////////////////////////WIADOMOSC TESTOWA/////////////////////////////////////////
}

//void RSA_Pass_Message(uint8_t *msg, uint8_t length){
//	for (uint8_t i = 0; i < length; i++) {
//	        Message[i] = msg[i];
//	    }
//	RSA_Driver_init(0, Message);
//}

void Encrypt_And_Add_Random_Message(uint8_t key_number){
	const uint8_t* key_data = get_rsa_key_set(key_number);
	if (key_data != NULL) {
		PubKey_st.mExponentSize = 3;
		PubKey_st.mModulusSize = 256;
		PubKey_st.pmExponent = (uint8_t *) PublicExponent;
		PubKey_st.pmModulus = (uint8_t *) key_data;
	}
	status = RSA_Encrypt(&PubKey_st, Message, sizeof(Message), output);
	if (status == RSA_SUCCESS){
		buffer_add(output, sizeof(output));
	}
}

uint8_t Decrypt_And_Check_RSA_Message(uint8_t key_number, uint8_t *received_message){
	const uint8_t* key_data = get_rsa_key_set(key_number);
    PrivKey_st.mExponentSize = sizeof(PrivateExponent);
    PrivKey_st.mModulusSize = 256;
    PrivKey_st.pmExponent = (uint8_t *) PrivateExponent;
    PrivKey_st.pmModulus = (uint8_t *) Modulus;

    status = RSA_Decrypt(&PrivKey_st, received_message, output, &outputSize);
    if (status == RSA_SUCCESS){
    		if(Buffercmp(Message, output, 16)){
    			return 1;
    		}
    		return 0;
    	}
    return 0;
}

/////////////////////////////////////////////////////////////LIB FUNCTIONS///////////////////////////

int32_t RSA_Encrypt(RSApubKey_stt *P_pPubKey,
                    const uint8_t *P_pInputMessage,
                    int32_t P_InputSize,
                    uint8_t *P_pOutput)
{
  int32_t status = RNG_SUCCESS ;
  RNGstate_stt RNGstate;
  RNGinitInput_stt RNGinit_st;
  RNGinit_st.pmEntropyData = entropy_data;
  RNGinit_st.mEntropyDataSize = sizeof(entropy_data);
  RNGinit_st.mPersDataSize = 0;
  RNGinit_st.mNonceSize = 0;

  status = RNGinit(&RNGinit_st, &RNGstate);
  if (status == RNG_SUCCESS)
  {
    RSAinOut_stt inOut_st;
    membuf_stt mb;

    mb.mSize = sizeof(preallocated_buffer);
    mb.mUsed = 0;
    mb.pmBuf = preallocated_buffer;

    /* Fill the RSAinOut_stt */
    inOut_st.pmInput = P_pInputMessage;
    inOut_st.mInputSize = P_InputSize;
    inOut_st.pmOutput = P_pOutput;

    /* Encrypt the message, this function will write sizeof(modulus) data */
    status = RSA_PKCS1v15_Encrypt(P_pPubKey, &inOut_st, &RNGstate, &mb);
  }
  return(status);
}

/**
  * @brief  RSA Decryption with PKCS#1v1.5
  * @param  P_pPrivKey The RSA private key structure, already initialized
  * @param  P_pInputMessage Input Message to be signed
  * @param  P_MessageSize Size of input message
  * @param  P_pOutput Pointer to output buffer
  * @retval error status: can be RSA_SUCCESS if success or RSA_ERR_GENERIC in case of fail
*/
int32_t RSA_Decrypt(RSAprivKey_stt * P_pPrivKey,
                    const uint8_t * P_pInputMessage,
                    uint8_t *P_pOutput,
                    int32_t *P_OutputSize)
{
  int32_t status = RSA_SUCCESS ;
  RSAinOut_stt inOut_st;
  membuf_stt mb;

  mb.mSize = sizeof(preallocated_buffer);
  mb.mUsed = 0;
  mb.pmBuf = preallocated_buffer;

  /* Fill the RSAinOut_stt */
  inOut_st.pmInput = P_pInputMessage;
  inOut_st.mInputSize = P_pPrivKey->mModulusSize;
  inOut_st.pmOutput = P_pOutput;

  /* Encrypt the message, this function will write sizeof(modulus) data */
  status = RSA_PKCS1v15_Decrypt(P_pPrivKey, &inOut_st, P_OutputSize, &mb);
  return(status);
}




/**
  * @brief  Compares two buffers.
  * @param  pBuffer, pBuffer1: buffers to be compared.
  * @param  BufferLength: buffer's length
  * @retval PASSED: pBuffer identical to pBuffer1
  *         FAILED: pBuffer differs from pBuffer1
  */
TestStatus Buffercmp(const uint8_t* pBuffer, uint8_t* pBuffer1, uint16_t BufferLength)
{
  while (BufferLength--)
  {
    if (*pBuffer != *pBuffer1)
    {
      return FAILED;
    }

    pBuffer++;
    pBuffer1++;
  }

  return PASSED;
}

/**
  * @brief  System Clock Configuration
  *         The system Clock is configured as follow :
  *            System Clock source            = PLL (HSI)
  *            SYSCLK(Hz)                     = 84000000
  *            HCLK(Hz)                       = 84000000
  *            AHB Prescaler                  = 1
  *            APB1 Prescaler                 = 2
  *            APB2 Prescaler                 = 1
  *            HSI Frequency(Hz)              = 16000000
  *            PLL_M                          = 16
  *            PLL_N                          = 336
  *            PLL_P                          = 4
  *            PLL_Q                          = 7
  *            VDD(V)                         = 3.3
  *            Main regulator output voltage  = Scale2 mode
  *            Flash Latency(WS)              = 2
  * @param  None
  * @retval None
  */
